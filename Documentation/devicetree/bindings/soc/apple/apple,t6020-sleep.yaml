## Documentation/devicetree/bindings/soc/apple/apple,t6020-sleep.yaml
```yaml
# SPDX-License-Identifier: (GPL-2.0-only OR BSD-2-Clause)
%YAML 1.2
---
$id: http://devicetree.org/schemas/soc/apple/apple,t6020-sleep.yaml#
$schema: http://devicetree.org/meta-schemas/core.yaml#

title: Apple T6020 system sleep registers

maintainers:
  - nekolyanich <me@nekolyanich.com>

description: |
  The register blocks a T6020-family SoC's suspend-to-RAM entry writes, named
  after the ADT's /arm-io/pmgr reg entries they are. The driver takes its steps
  from an ordered table per SoC, each a block by name and an offset in it. The
  blocks overlap other drivers' ranges and are not claimed.

properties:
  compatible:
    const: apple,t6020-sleep

  reg:
    maxItems: 30

  reg-names:
    items:
      - const: pmgr
      - const: aon
      - const: soc-east
      - const: clkgen
      - const: commit
      - const: pmgr40
      - const: afr
      - const: pms
      - const: pll
      - const: dvfs-e
      - const: cpm-e
      - const: dvfs-p0
      - const: cpm-p0
      - const: dvfs-p1
      - const: cpm-p1
      - const: aop-gpio
      - const: aop-spmi0
      - const: aop-spmi1
      - const: nub-spmi
      - const: mcc-plane0
      - const: wake
      - const: gfx-asc
      - const: dcp-asc
      - const: dcpext0-asc
      - const: dcpext1-asc
      - const: ans-asc
      - const: mcc0
      - const: mcc1
      - const: mcc2
      - const: mcc3

  apple,pmu:
    $ref: /schemas/types.yaml#/definitions/phandle
    description:
      The PMU on the SPMI bus, for the boot stage and the RTC alarm a full entry writes.

  apple,coprocs:
    $ref: /schemas/types.yaml#/definitions/phandle-array
    description:
      The co-processors whose drivers register a sleep stop: the DCPs, in table order.

  apple,smc:
    $ref: /schemas/types.yaml#/definitions/phandle
    description:
      The SMC, told of the sleep as macOS tells it (MBSE, the AP idle notice).

required:
  - compatible
  - reg
  - reg-names
  - apple,pmu

additionalProperties: false
```
